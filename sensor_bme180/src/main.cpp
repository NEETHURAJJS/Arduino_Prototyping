#include <Wire.h>
#include <SPI.h>
#include <Adafruit_BMP085.h>
#include <Adafruit_GFX.h>
#include <Adafruit_SSD1306.h>

#define SCREEN_WIDTH 128 // OLED display width, in pixels
#define SCREEN_HEIGHT 64 // OLED display height, in pixels
// Declaration for an SSD1306 display connected to I2C (SDA, SCL pins)
#define OLED_RESET -1 // Reset pin # (or -1 if sharing Arduino reset pin)
Adafruit_SSD1306 display(SCREEN_WIDTH, SCREEN_HEIGHT, &Wire, OLED_RESET);
#define NUMFLAKES 10 // Number of snowflakes in the animation example
#define LOGO_HEIGHT 16
#define LOGO_WIDTH 16
#define bitmap_height   32
#define bitmap_width    32
static const unsigned char PROGMEM logo_bmp[] =
    {B00000000, B11000000,
     B00000001, B11000000,
     B00000001, B11000000,
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     B00000000, B00110000};

//temperature
// 'celsius', 64x32px
// 'celsius', 64x32px
/*const unsigned char epd_bitmap_celsius [] PROGMEM = {
	0x00, 0x38, 0x00, 0x00, 0x00, 0x6c, 0x00, 0x00, 0x00, 0xc6, 0x00, 0x00, 0x00, 0x86, 0x00, 0x00, 
	0x00, 0x86, 0x00, 0x00, 0x3c, 0x86, 0x00, 0x00, 0x3c, 0x86, 0x00, 0x00, 0x00, 0x86, 0x00, 0x00, 
	0x0e, 0x86, 0x00, 0x00, 0x00, 0x86, 0x0e, 0x08, 0x00, 0x86, 0x3f, 0x9c, 0x0e, 0x86, 0x20, 0x96, 
	0x00, 0x86, 0x60, 0x9c, 0x3c, 0x96, 0x60, 0x00, 0x3c, 0x96, 0x60, 0x00, 0x00, 0x96, 0x60, 0x00, 
	0x0e, 0x96, 0x60, 0x00, 0x00, 0x96, 0x60, 0x80, 0x00, 0x96, 0x60, 0x80, 0x0e, 0x96, 0x21, 0x80, 
	0x00, 0x96, 0x3f, 0x00, 0x3c, 0x96, 0x00, 0x00, 0x3c, 0x96, 0x00, 0x00, 0x00, 0x96, 0x00, 0x00, 
	0x00, 0x96, 0x00, 0x00, 0x01, 0x93, 0x00, 0x00, 0x01, 0x39, 0x00, 0x00, 0x01, 0x69, 0x00, 0x00, 
	0x01, 0x3b, 0x00, 0x00, 0x01, 0x82, 0x00, 0x00, 0x00, 0xce, 0x00, 0x00, 0x00, 0x78, 0x00, 0x00
};
*/
//temperature
/*
const unsigned char epd_bitmap_climate_change [] PROGMEM = {
	0x00, 0x00, 0x00, 0x00, 0x00, 0x00, 0x01, 0x00, 0x00, 0x00, 0x08, 0x20, 0x00, 0x00, 0x03, 0xc0, 
	0x00, 0x00, 0x6e, 0xec, 0x00, 0x00, 0x0b, 0xf0, 0x00, 0x00, 0x47, 0xf0, 0x00, 0x03, 0xfb, 0xf0, 
	0x00, 0x07, 0xfd, 0xf0, 0x00, 0x0f, 0xfe, 0xf0, 0x00, 0x5f, 0xff, 0xf0, 0x01, 0xff, 0xff, 0x60, 
	0x03, 0xff, 0xff, 0x00, 0x03, 0xff, 0xff, 0x00, 0x03, 0xff, 0xff, 0x00, 0x0f, 0xff, 0xff, 0xf0, 
	0x1f, 0xff, 0xff, 0xf8, 0x3f, 0xff, 0xff, 0xfc, 0x3f, 0xff, 0xff, 0xfc, 0x3f, 0xff, 0xff, 0xfc, 
	0x3f, 0xff, 0xff, 0xfc, 0x3f, 0xff, 0xff, 0xfc, 0x3f, 0xff, 0xff, 0xf8, 0x1f, 0xff, 0xff, 0xf0, 
	0x07, 0xff, 0xff, 0xe0, 0x00, 0x00, 0x00, 0x00, 0x00, 0x00, 0x01, 0x00, 0x06, 0x18, 0x63, 0x80, 
	0x0e, 0x38, 0xe3, 0x80, 0x0f, 0x39, 0xe7, 0x80, 0x0e, 0x38, 0xe3, 0x80, 0x3f, 0xff, 0xff, 0xfa
};
*/
/*
//pressure
const unsigned char epd_bitmap_gauge [] PROGMEM = {
	0x00, 0x0f, 0xf0, 0x00, 0x00, 0x7c, 0x3e, 0x00, 0x01, 0xc1, 0x83, 0x80, 0x03, 0x01, 0x80, 0xc0, 
	0x06, 0x41, 0x82, 0x60, 0x0c, 0x61, 0x86, 0x30, 0x18, 0x20, 0x04, 0x18, 0x30, 0x00, 0x00, 0x0c, 
	0x20, 0x00, 0x00, 0x04, 0x6c, 0x00, 0x04, 0x36, 0x46, 0x00, 0x0c, 0x62, 0x40, 0x00, 0x18, 0x02, 
	0xc0, 0x00, 0x30, 0x03, 0xc0, 0x01, 0xe0, 0x03, 0x80, 0x03, 0xc0, 0x01, 0xbc, 0x06, 0x60, 0x3d, 
	0xbc, 0x06, 0x60, 0x3d, 0x80, 0x03, 0xc0, 0x01, 0xc0, 0x01, 0x80, 0x03, 0xff, 0xf8, 0x1f, 0xff, 
	0x40, 0x0c, 0x30, 0x02, 0x40, 0x07, 0xe0, 0x02, 0x60, 0x01, 0x80, 0x06, 0x20, 0x00, 0x00, 0x04, 
	0x30, 0x00, 0x00, 0x0c, 0x18, 0x00, 0x00, 0x18, 0x0c, 0x00, 0x00, 0x30, 0x06, 0x00, 0x00, 0x60, 
	0x03, 0x00, 0x00, 0xc0, 0x01, 0xc0, 0x03, 0x80, 0x00, 0x7c, 0x3e, 0x00, 0x00, 0x0f, 0xf0, 0x00
};
*/
//Altitude
const unsigned char epd_bitmap_altitude_1_ [] PROGMEM = {
	0x18, 0x00, 0x00, 0x00, 0x1c, 0x00, 0x00, 0x00, 0x1e, 0x00, 0x00, 0x00, 0x0f, 0x00, 0x00, 0x00, 
	0x00, 0x00, 0x00, 0x00, 0x3f, 0xff, 0xff, 0xe0, 0x1f, 0xff, 0xff, 0xf0, 0x0f, 0xff, 0xff, 0xf8, 
	0x1c, 0xff, 0xff, 0xe0, 0x00, 0x1e, 0x00, 0x00, 0x00, 0x3c, 0x00, 0x00, 0x00, 0x79, 0x00, 0x00, 
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	0x01, 0xff, 0xff, 0xfc, 0x03, 0xff, 0xff, 0xfc, 0x07, 0xff, 0xff, 0xfc, 0x07, 0xff, 0xff, 0xfc
};


#define seaLevelPressure_hPa 1013.25
Adafruit_BMP085 bmp;
float Temperature;
int32_t Pressure;
float Altitude;

bool blue_state = false;
// const int led_pins(3)= {LED_RED , LED_GREEN ,LED_BLUE};
int ledState = LOW;
void testdrawstyles(void);
void testdrawbitmap(void);
void showBitmap(void);

void setup()
{
  Serial.begin(115200);

  // SSD1306_SWITCHCAPVCC = generate display voltage from 3.3V internally
  if (!display.begin(SSD1306_SWITCHCAPVCC, 0x3C))
  {
    Serial.println(F("SSD1306 allocation failed"));
    for (;;)
      ; // Don't proceed, loop forever
  }
  display.display();
  display.clearDisplay();
  display.display();
  delay(2000);
  if (!bmp.begin())
  {
    Serial.println("Could not find a valid BMP085 sensor, check wiring!");
    display.display();
    display.clearDisplay();
    delay(2000);
    while (1)
    {
    }
  }
}
void drawCentreString(const char *buf, int x, int y);
void testdrawbitmap();
void loop()
{
  showBitmap();
}
void showBitmap (void)
  {
    /*
  Temperature = bmp.readTemperature();
  

  display.setTextSize(2);
  display.setTextColor(WHITE);
  // display.setCursor(64, 0);
  drawCentreString("BME180", 64, 0);
  
  display.setTextSize(2);
  display.setTextColor(WHITE);
  display.setCursor(64,16+4);
  //display.print("Temperature=");
  display.println(Temperature);
  //display.println(F(" *C"));
  
  display.drawBitmap(0, 16, epd_bitmap_climate_change, bitmap_height, bitmap_width, WHITE);


  Serial.print("Temperature: ");
  Serial.println(Temperature);
  
  
  Pressure=bmp.readPressure();
  
  display.setTextSize(2);
  display.setTextColor(WHITE);
  // display.setCursor(64, 0);
  drawCentreString("BME180", 64, 0);
  display.setCursor(32, 32+4);
  //display.print("Pressure = ");
  display.print(bmp.readPressure());
  //display.println(" Pa");
  
  display.drawBitmap(0, 16, epd_bitmap_gauge, bitmap_height, bitmap_width, WHITE);

  Serial.print("Pressure=");
  Serial.println(Pressure);
*/
  Altitude=bmp.readAltitude();
 
  display.setTextSize(2);
  display.setTextColor(WHITE);
  drawCentreString("BME180", 64, 0);
  display.setCursor(64, 16+4);
  //display.print("Altitude = ");
  display.print(bmp.readAltitude());
  //display.println(" m");
  display.drawBitmap(0, 16, epd_bitmap_altitude_1_, bitmap_height, bitmap_width, WHITE);

  Serial.print("altitude=");
  Serial.println(Altitude);

/*
display.setTextSize(1);
display.setTextColor(WHITE);
display.setCursor(10, 0);
display.print("Pressure at sealevel (calculated) = ");
display.print(bmp.readSealevelPressure());
display.println(" Pa");
Serial.println("sealevelpressure=");
s
display.setTextSize(1);
display.setTextColor(WHITE);
display.setCursor(10, 0);
display.print("Real altitude = ");
display.print(bmp.readAltitude(seaLevelPressure_hPa * 100));
display.println(" meters");
Serial.println(" Realaltitude");
 */
  display.display();
  delay(2000);
  display.clearDisplay();
  }

void drawCentreString(const char *buf, int x, int y)
{
  int16_t x1, y1;
  uint16_t w, h;
  display.getTextBounds(buf, 0, 0, &x1, &y1, &w, &h); // calc width of new string

  // Serial.print("x: ");
  // Serial.print(x);
  // Serial.print(", y: ");
  // Serial.print(y);
  // Serial.print(", x1: ");
  // Serial.print(x1);
  // Serial.print(", y1: ");
  // Serial.print(y1);
  // Serial.print(", w: ");
  // Serial.print(w);
  // Serial.print(", h: ");
  // Serial.print(h);
  // Serial.println();
  

  display.setCursor(x - w / 2, y);
  display.println(buf);


}

void testdrawbitmap(void) {
  display.clearDisplay();

  display.drawBitmap(
    (display.width()  - LOGO_WIDTH ) / 2,
    (display.height() - LOGO_HEIGHT) / 2,
    epd_bitmap_altitude_1_, LOGO_WIDTH, LOGO_HEIGHT, 1);
  display.display();
  delay(1000);}